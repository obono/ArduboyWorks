#include "common.h"

/*  Defines  */

enum STATE_T : uint8_t {
    STATE_INIT = 0,
    STATE_TOP,
    STATE_CREDIT,
    STATE_STARTED,
};

/*  Local Functions  */

static void handleInit(void);
static void handleTop(void);
static void handleAnyButton(void);

static void onTop(void);
static void onStart(void);
static void onCredit(void);

static void drawInit(void);
static void drawTop(void);
static void drawCredit(void);
static void drawTitleLogo(int16_t x, int16_t y);
static void drawText(const char *p, int lines);

/*  Local Functions (macros)  */

#define callHandlerFunc(n)  ((void (*)(void)) pgm_read_ptr(handlerFuncTable + n))()
#define callDrawerFunc(n)   ((void (*)(void)) pgm_read_ptr(drawerFuncTable + n))()

/*  Local Constants  */

PROGMEM static const uint8_t imgTitleUpper[] = { // 126x32
    0x00, 0x00, 0x00, 0x00, 0x00, 0x80, 0x60, 0x18, 0x06, 0x02, 0x02, 0x82, 0x82, 0x82, 0x82, 0x82,
    0x82, 0x82, 0x42, 0x42, 0x42, 0xBE, 0xC0, 0x38, 0x10, 0x08, 0x04, 0x04, 0x82, 0x42, 0xC1, 0x01,
    0x01, 0x01, 0x02, 0x02, 0x06, 0xFC, 0x80, 0xC0, 0x60, 0x10, 0x08, 0x04, 0x04, 0x82, 0x42, 0xC1,
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    0x00, 0x80, 0xC0, 0xC0, 0xE0, 0xE0, 0xC0, 0xC0
};

PROGMEM static const uint8_t imgTitleLower[] = { // 81x20
    0x00, 0x00, 0x00, 0x00, 0x00, 0x80, 0xC4, 0x66, 0x3B, 0x39, 0x1E, 0x0F, 0x02, 0xFE, 0xFC, 0x60,
    0x09, 0xCD, 0xF6, 0xFF, 0xFF, 0xFF, 0x3E, 0x46, 0x3E, 0x5E, 0x2F, 0xC7, 0xF7, 0xFA, 0xFC, 0x7F,
    0x9F, 0x6F, 0x17, 0x0B, 0x04, 0x03, 0x00, 0x00, 0x00, 0x00, 0x00, 0x00, 0xC0, 0xE0, 0xF8, 0xFC,
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    0x00, 0x00, 0x00
};


PROGMEM static const char creditText[] = \
        "I WANT $5 QUADRILLION\0\0\0" APP_RELEASED "\0PROGRAMMED BY OBONO\0\0" \
        "THIS PROGRAM IS\0RELEASED UNDER\0THE MIT LICENSE.\0\e";

PROGMEM static void(*const handlerFuncTable[])(void) = {
    handleInit, handleTop, handleAnyButton
};

PROGMEM static void(*const drawerFuncTable[])(void) = {
    drawInit, drawTop, drawCredit
};

/*  Local Variables  */

static STATE_T  state = STATE_INIT;

/*---------------------------------------------------------------------------*/
/*                              Main Functions                               */
/*---------------------------------------------------------------------------*/

void initTitle(void)
{
    if (state == STATE_INIT) {
        counter = 30;
    } else {
        onTop();
    }
}

MODE_T updateTitle(void)
{
    callHandlerFunc(state);
    randomSeed(rand() ^ micros()); // Shuffle random
    return (state == STATE_STARTED) ? MODE_GAME : MODE_TITLE;
}

void drawTitle(void)
{
    if (state == STATE_STARTED) return;
    callDrawerFunc(state);
    isInvalid = false;
}

/*---------------------------------------------------------------------------*/
/*                             Control Functions                             */
/*---------------------------------------------------------------------------*/

static void handleInit(void)
{
    if (--counter == 0) onTop();
    isInvalid = true;
}

static void handleTop(void)
{
    handleMenu();
}

static void handleAnyButton(void)
{
    if (ab.buttonDown(A_BUTTON | B_BUTTON)) {
        playSoundClick();
        state = STATE_TOP;
        isInvalid = true;
    }
}

/*---------------------------------------------------------------------------*/
/*                               Menu Handlers                               */
/*---------------------------------------------------------------------------*/

static void onTop(void)
{
    clearMenuItems();
    addMenuItem(F("GAME START"), onStart);
    addMenuItem(F("CREDIT"), onCredit);
    setMenuItemPos(0);
    setMenuCoords(28, 53, 72, 11, false, true);
    state = STATE_TOP;
    isInvalid = true;
}

static void onStart(void)
{
    state = STATE_STARTED;
}

static void onCredit(void)
{
    playSoundClick();
    state = STATE_CREDIT;
    isInvalid = true;
}

/*---------------------------------------------------------------------------*/
/*                              Draw Functions                               */
/*---------------------------------------------------------------------------*/

static void drawInit(void)
{
    ab.clear();
    drawTitleLogo(random(-counter, counter + 1), random(-counter, counter + 1));
}

static void drawTop(void)
{
    if (isInvalid) {
        ab.clear();
        drawTitleLogo(0, 0);
    }
    drawMenuItems(isInvalid);
}

static void drawCredit(void)
{
    if (isInvalid) {
        ab.clear();
        drawText(creditText, 11);
    }
}

/*---------------------------------------------------------------------------*/

static void drawTitleLogo(int16_t x, int16_t y)
{
    ab.drawBitmap(x, y, imgTitleUpper, 126, 32);
    ab.drawBitmap(x + 47, y + 32, imgTitleLower, 81, 20);
}

static void drawText(const char *p, int16_t y)
{
    while (pgm_read_byte(p) != '\e') {
        uint8_t len = strnlen_P(p, 21);
        ab.printEx(64 - len * 3, y, (const __FlashStringHelper *) p);
        p += len + 1;
        y += (len == 0) ? 2 : 6;
    }
}
